## custom-yocto-build/meta-everest-dev/conf/layer.conf
```bitbake
BBPATH .= ":${LAYERDIR}"

BBFILES += "${LAYERDIR}/recipes-*/*/*.bb \
            ${LAYERDIR}/recipes-*/*/*.bbappend"

BBFILE_COLLECTIONS += "everest-dev"
BBFILE_PATTERN_everest-dev = "^${LAYERDIR}/"
BBFILE_PRIORITY_everest-dev = "100"
```
